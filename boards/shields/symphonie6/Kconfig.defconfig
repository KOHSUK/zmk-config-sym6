## boards/shields/symphonie6/Kconfig.defconfig
```kconfig
if SHIELD_SYMPHONIE6_LEFT

# Name must be less than 16 characters long!
config ZMK_KEYBOARD_NAME
    default "Symphonie Nr.6"

config ZMK_SPLIT_ROLE_CENTRAL
    default y

endif

if SHIELD_SYMPHONIE6_LEFT || SHIELD_SYMPHONIE6_RIGHT

config ZMK_SPLIT
    default y

endif
```

## boards/shields/symphonie6/Kconfig.shield
```kconfig
config SHIELD_SYMPHONIE6_LEFT
    def_bool $(shields_list_contains,symphonie6_left)

config SHIELD_SYMPHONIE6_RIGHT
    def_bool $(shields_list_contains,symphonie6_right)
```
